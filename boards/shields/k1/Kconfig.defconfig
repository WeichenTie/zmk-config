## boards/shields/k1/Kconfig.defconfig
```kconfig
if SHIELD_K1_LEFT

# Name must be less than 16 characters long!
config ZMK_KEYBOARD_NAME
    default "k1"

config ZMK_SPLIT_ROLE_CENTRAL
    default y

endif

if SHIELD_K1_LEFT || SHIELD_K1_RIGHT

config ZMK_SPLIT
    default y

endif
```

## boards/shields/k1/Kconfig.shield
```kconfig
config SHIELD_K1_LEFT
    def_bool $(shields_list_contains,k1_left)

config SHIELD_K1_RIGHT
    def_bool $(shields_list_contains,k1_right)
```
